## build/conf/bblayers.conf
```bitbake
# POKY_BBLAYERS_CONF_VERSION is increased each time build/conf/bblayers.conf
# changes incompatibly
POKY_BBLAYERS_CONF_VERSION = "2"

BBPATH = "${TOPDIR}"
BBFILES ?= ""

BBLAYERS ?= " \
  /home/knap-linux/Documents/yocto/ver2/poky/meta \
  /home/knap-linux/Documents/yocto/ver2/poky/meta-poky \
  /home/knap-linux/Documents/yocto/ver2/poky/meta-yocto-bsp \
  /home/knap-linux/Documents/yocto/ver2/poky/meta-raspberrypi \
  /home/knap-linux/Documents/yocto/ver2/poky/meta-openembedded/meta-oe \
  /home/knap-linux/Documents/yocto/ver2/poky/meta-openembedded/meta-multimedia \
  /home/knap-linux/Documents/yocto/ver2/poky/meta-openembedded/meta-python \
  "
```
